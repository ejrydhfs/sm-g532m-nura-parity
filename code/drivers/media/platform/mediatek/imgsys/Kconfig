## code/drivers/media/platform/mediatek/imgsys/Kconfig
```kconfig
# SPDX-License-Identifier: GPL-2.0-only
config VIDEO_MTK_IMGSYS
	tristate "MediaTek MT6735 IMGSYS/ISP platform driver"
	depends on MEDIA_SUPPORT
	depends on VIDEO_DEV
	depends on COMMON_CLK
	depends on OF
	depends on PM
	help
	  Platform, clock, power and reset driver for the MediaTek MT6735 /
	  MT6737T image signal processor (IMGSYS) block.

	  The driver owns the ISP core register windows, the six IMGSYS clock
	  gates and the ISP power domain, performs the documented Pass 1,
	  Pass 2, CAMSV and CAMSV2 soft resets on probe, and exposes the
	  mapped register windows through debugfs for diagnostics.

	  The ISP capture pipeline itself is not implemented: running the
	  Pass 1 / Pass 2 / CAM_SV / DSP pipelines and the on-demand
	  ISP_RESET_* ioctls requires the proprietary MTK camera userspace ABI
	  (libcamdrv) plus the ISP firmware images, neither of which is
	  available.  That part, including the deterministic reset sequences,
	  is implemented by the separate "camera-isp" character driver
	  (CONFIG_VIDEO_MTK_ISP), which maps the same windows itself.  This
	  driver therefore provides no V4L2 entity and no video node.

	  To compile this driver as a module, choose M here: the module will
	  be called mtk-imgsys.
```

## code/drivers/media/platform/mediatek/isp/Kconfig
```kconfig
# SPDX-License-Identifier: GPL-2.0-only
config VIDEO_MTK_ISP
	tristate "MediaTek MT6735 camera ISP character driver"
	depends on MEDIA_SUPPORT
	depends on VIDEO_DEV
	depends on COMMON_CLK
	depends on OF
	depends on PM
	help
	  Character driver for the MediaTek MT6735 / MT6737T camera ISP
	  ("camera-isp").  It implements the downstream libcamdrv ABI
	  published in include/uapi/linux/mtk_isp.h: register window mmap,
	  register read/write, the hold-register write buffers, per-user
	  interrupt status/wait/mark/clear with user keys, the Pass-1 /
	  Pass-1-D / CAMSV DMA buffer rings with SOF-time base address and
	  RCNT_INC programming, the Pass-2 early-done queue, reset, register
	  scenario and burst queue controls.

	  Frame completion is derived exclusively from the ISP interrupt
	  lines; no timer or polled completion path exists.  Interrupt
	  status registers are read-to-clear, so they are sampled once per
	  interrupt and never from a diagnostic path.

	  The ISP power domain and the IMGSYS clock gates are shared with
	  the mtk-imgsys platform driver; this driver takes its own
	  references so register access is always safe.

	  To compile this driver as a module, choose M here: the module will
	  be called mtk-isp.
```

## code/drivers/media/platform/mediatek/seninf/Kconfig
```kconfig
# SPDX-License-Identifier: GPL-2.0-only
config VIDEO_MTK_SENINF
	tristate "MediaTek MT6735 SENINF driver"
	depends on MEDIA_SUPPORT && VIDEO_DEV && MEDIA_CONTROLLER && VIDEO_V4L2_SUBDEV_API && OF && COMMON_CLK
	select V4L2_ASYNC
	select V4L2_FWNODE
	help
	  Say Y or M here to enable the MediaTek MT6735 SENINF (sensor
	  interface) driver.  The driver owns the camera subsystem media
	  device, binds the sensor subdevices described in the device tree
	  through the V4L2 async framework, and provides the per-camera MCLK
	  output clocks.  The MIPI CSI-2 lane, D-PHY and timing programming is
	  done by the proprietary MTK camera userspace and is not implemented.

	  To compile this driver as a module, choose M here: the module will be
	  called mtk-seninf.
```

## code/drivers/misc/mediatek/Kconfig
```kconfig
# SPDX-License-Identifier: GPL-2.0-only

source "drivers/misc/mediatek/vcodec/Kconfig"
source "drivers/misc/mediatek/ccci/Kconfig"
source "drivers/misc/mediatek/ccci_c2k/Kconfig"
source "drivers/misc/mediatek/ccci_cldma/Kconfig"
source "drivers/misc/mediatek/ccci_util/Kconfig"
source "drivers/misc/mediatek/btif/Kconfig"
source "drivers/misc/mediatek/connectivity/Kconfig"
source "drivers/misc/mediatek/aee/Kconfig"
source "drivers/misc/mediatek/clkbuf/Kconfig"
```

## code/drivers/misc/mediatek/accdet/Kconfig
```kconfig
# SPDX-License-Identifier: GPL-2.0-only
config MTK_ACCDET
	tristate "MediaTek MT6328 PMIC accessory detection support"
	depends on MFD_MT6397 || COMPILE_TEST
	help
	  Say Y here to enable the accessory detection (headset jack) block
	  inside the MediaTek MT6328 PMIC.  It reports headset plug/unplug,
	  3-pole/4-pole cable type and headset button events through the
	  accdet notifier API.

	  The MT6328 PMIC itself is supported by the MFD_MT6397 driver.

	  If unsure, say N.
```

## code/drivers/misc/mediatek/aee/Kconfig
```kconfig
# SPDX-License-Identifier: GPL-2.0
config MTK_AEE_FEATURE
	bool "MediaTek AEE/AED exception dump client"
	depends on ARCH_MEDIATEK || COMPILE_TEST
	help
	  AEE (Android Exception Engine) / AED (Android Exception Device)
	  client interface of MT6735/MT6737T: the /dev/aed0 (external
	  exception, EE) and /dev/aed1 (kernel exception, KE) misc devices,
	  the AE_Msg request/response protocol used by the ROM AEE client,
	  the exception-dump ("DB") ioctls, the /proc/aed entries and the
	  aed_md_exception_api()/aed_md32_exception_api()/
	  aed_scp_exception_api()/aed_combo_exception_api() entry points that
	  the CCCI exception path calls when the modem, the DSP or the SCP
	  reports an exception.

	  Ported from the Samsung/MTK 3.18 downstream kernel
	  drivers/misc/mediatek/aee/ (aed/aed-main.c, common/aee-common.c).

	  Say Y to get /dev/aed0 and to deliver modem exception dumps to
	  userspace.
```

## code/drivers/misc/mediatek/btif/Kconfig
```kconfig
# SPDX-License-Identifier: GPL-2.0
#
# MediaTek BTIF (Bluetooth interface) controller driver.
#
# Ported from Samsung/MTK downstream drivers/misc/mediatek/btif.

config MTK_BTIF
	tristate "MediaTek BTIF DMA controller"
	depends on ARCH_MEDIATEK || COMPILE_TEST
	depends on HAS_DMA
	help
	  BTIF is the DMA-capable serial interface between the application
	  processor and the MediaTek connectivity subsystem (CONSYS).  It is
	  used to carry the STP protocol for Bluetooth, GPS and FM.

	  Say M here to build the driver as a module.  The module will be
	  called mtk_btif.
```

## code/drivers/misc/mediatek/ccci/Kconfig
```kconfig
# SPDX-License-Identifier: GPL-2.0
config MTK_CCCI
	bool "MediaTek CCCI modem subsystem (eccci core)"
	depends on ARCH_MEDIATEK || COMPILE_TEST
	depends on OF
	depends on FW_LOADER
	select MTK_CCCI_CLDMA
	select MTK_CCCI_UTIL
	select MTK_CCMNI
	help
	  Core of the MediaTek CCCI (Cross Chip Communication Interface)
	  modem subsystem for MT6735/MT6737T: modem object and state machine,
	  the CCIF control transport, the modem image loader, character
	  ports (/dev/ccci_monitor, /dev/ttyC0..C4, /dev/ccci_fs, ...) and the
	  CCMNI network binding hooks.

	  The CLDMA data engine (MTK_CCCI_CLDMA), the log/dump helpers
	  (MTK_CCCI_UTIL), the CCMNI netdev driver (MTK_CCMNI) and the
	  C2K/MD3 companion (MTK_CCCI_C2K) are separate options that the
	  platform configuration must enable alongside this one.

	  Modem firmware (md1img/md3img) is loaded with request_firmware() and
	  must be present in the firmware search path.

	  Say N unless you are building for such a modem platform.

config MTK_MD_SBP_CUSTOM_VALUE
	string "Configure modem 1 default bind operator ID"
	depends on MTK_CCCI
	default ""
	help
	  Default MD SBP (Single Binary Platform) operator/bind value
	  reported to userspace by CCCI_IOC_GET_MD_SBP_CFG and used for the
	  handshake-2 runtime data when userspace has not called
	  CCCI_IOC_SET_MD_SBP_CFG.

	  Ported from Samsung/MTK 3.18 ccci_util/Kconfig:99-105.  The value is
	  parsed as an unsigned integer (kstrtouint base 0); an empty string,
	  which is the ROM default, disables the SBP feature.

config MTK_MD2_SBP_CUSTOM_VALUE
	string "Configure modem 2 default bind operator ID"
	depends on MTK_CCCI
	default ""
	help
	  Same as MTK_MD_SBP_CUSTOM_VALUE for modem 2
	  (Samsung/MTK 3.18 ccci_util/Kconfig:107-113).
```

## code/drivers/misc/mediatek/ccci_c2k/Kconfig
```kconfig
# SPDX-License-Identifier: GPL-2.0
#
# C2K (MD3) dual-modem support for the MT6735/MT6737T CCCI subsystem
#

config MTK_CCCI_C2K
	bool "MediaTek C2K (MD3) dual-modem support"
	depends on MTK_CCCI
	help
	  Support the second (C2K/CDMA) modem instance of the MediaTek
	  MT6735/MT6737T CCCI subsystem.  On this platform MD3 is a CCIF modem
	  driven through the CCCI core; the driver supplies the C2K hardware
	  bring-up (boot slave, INFRA_AO C2K control, C2K sysreset, sleep clock
	  selection), the C2K channel map, IRAT coordination with MD1 and the
	  /sys/kernel/c2k interface.
```

## code/drivers/misc/mediatek/ccci_cldma/Kconfig
```kconfig
# SPDX-License-Identifier: GPL-2.0
config MTK_CCCI_CLDMA
	bool "MediaTek CCCI CLDMA modem data transport"
	help
	  CLDMA is the scatter/gather DMA engine used to carry MD1 packet data
	  between the application processor and the MediaTek modem on
	  MT6735/MT6737T SoCs. It implements the CCCI CLDMA API declared in
	  include/linux/ccci.h and is driven by the CCCI core driver.

	  Say Y here to support the MediaTek CLDMA transport.
```

## code/drivers/misc/mediatek/ccci_util/Kconfig
```kconfig
# SPDX-License-Identifier: GPL-2.0-only
#
# MediaTek CCCI utility driver
#

config MTK_CCCI_UTIL
	bool "MediaTek CCCI utility driver"
	help
	  CCCI (Cross Chip Communication Interface) utility driver for
	  MediaTek modems.  Provides the modem log/dump ring buffers,
	  the /dev/ccci_log and /dev/ccci_dump character devices, the
	  MD image check-header parser and the debugfs views used to
	  diagnose the CCCI core, CLDMA engine and CCMNI network ports.

	  The driver is selected by the CCCI core (MTK_CCCI).
```

## code/drivers/misc/mediatek/clkbuf/Kconfig
```kconfig
# SPDX-License-Identifier: GPL-2.0-only

config MTK_CLKBUF
	bool "MT6735 RF clock buffer control"
	depends on ARCH_MEDIATEK || COMPILE_TEST
	depends on PM
	depends on MFD_SYSCON
	help
	  Control of the four RF clock buffers (BB/MD, CONN, NFC, AUDIO) of
	  the MT6735/MT6737T.  The buffers are driven either through the SPM
	  MD BSI control register while the modem is powered, or through the
	  AP BSI command-word generator, exactly as the vendor SPM driver
	  does.

	  The driver implements clk_buf_ctrl()/clk_buf_get_swctrl_status()
	  for the CCCI RPC service (IPC_RPC_GET_RF_CLK_BUF_OP) and the WMT
	  CONSYS co-clock power sequence, and exports the sysfs knob
	  /sys/power/clk_buf/clk_buf_ctrl.

	  This option must be built in (=y), not modular: it registers a
	  group below power_kobj, which the kernel does not export to
	  modules.
```

## code/drivers/misc/mediatek/connectivity/Kconfig
```kconfig
# SPDX-License-Identifier: GPL-2.0
#
# MediaTek connectivity subsystem (WMT/CONSYS, WLAN, BT, GPS, FM).
#
# Ported from Samsung/MTK downstream drivers/misc/mediatek/connectivity.

source "drivers/misc/mediatek/connectivity/wmt/Kconfig"
source "drivers/misc/mediatek/connectivity/wlan/Kconfig"
source "drivers/misc/mediatek/connectivity/bt/Kconfig"
source "drivers/misc/mediatek/connectivity/gps/Kconfig"
source "drivers/misc/mediatek/connectivity/fm/Kconfig"
```

## code/drivers/misc/mediatek/connectivity/bt/Kconfig
```kconfig
# SPDX-License-Identifier: GPL-2.0
#
# MediaTek Bluetooth: BTIF transport glue and HCI over STP.

config MTK_WCN_BT
	tristate "MediaTek WCN Bluetooth (STP/HCI) driver"
	depends on MTK_WCN_WMT
	depends on BT
	depends on ARCH_MEDIATEK || COMPILE_TEST
	help
	  Bluetooth host driver for the MediaTek connectivity subsystem.
	  HCI packets are carried over the STP Bluetooth channel which runs
	  on the BTIF interface.

	  The module is called mtk_wcn_bt.
```

## code/drivers/misc/mediatek/connectivity/fm/Kconfig
```kconfig
# SPDX-License-Identifier: GPL-2.0
#
# MediaTek FM radio (MT6627 FM function) over STP.

config MTK_WCN_FM
	tristate "MediaTek WCN FM radio driver"
	depends on MTK_WCN_WMT
	depends on MEDIA_SUPPORT
	depends on VIDEO_DEV
	depends on ARCH_MEDIATEK || COMPILE_TEST
	select RFKILL
	help
	  V4L2 radio driver for the MediaTek MT6627 FM receiver embedded in
	  the connectivity subsystem.  Tuning and RDS are carried over the
	  STP FM channel; audio is routed through the SoC I2S interface.

	  The module is called mtk_wcn_fm.
```

## code/drivers/misc/mediatek/connectivity/gps/Kconfig
```kconfig
# SPDX-License-Identifier: GPL-2.0
#
# MediaTek GPS (MT3326 / MT6627 GPS function) over STP.

config MTK_WCN_GPS
	tristate "MediaTek WCN GPS driver"
	depends on MTK_WCN_WMT
	depends on ARCH_MEDIATEK || COMPILE_TEST
	select RFKILL
	help
	  Driver for the MediaTek connectivity subsystem GPS function.  The
	  GPS function is powered through WMT and exchanges NMEA/MTK binary
	  frames with the connectivity SoC over the STP GPS channel.

	  Two mutually exclusive userspace interfaces are provided: the
	  standard GNSS character device (when CONFIG_GNSS is enabled) and
	  the vendor /dev/stpgps character device used by the Android GPS
	  HAL of the SM-G532M ROM.

	  The module is called mtk_wcn_gps.
```

## code/drivers/misc/mediatek/connectivity/wlan/Kconfig
```kconfig
# SPDX-License-Identifier: GPL-2.0
#
# MediaTek WLAN (MT6627 on CONSYS, AHB/PDMA host interface).

config MTK_WCN_WLAN
	tristate "MediaTek WCN WLAN driver"
	depends on MTK_WCN_WMT
	depends on CFG80211
	depends on ARCH_MEDIATEK || COMPILE_TEST
	select CRC32
	select FW_LOADER
	help
	  Host driver for the MediaTek WLAN function embedded in the
	  connectivity subsystem (MT6628/MT6627 gen2, AHB host interface
	  with optional AP-DMA).  It owns the AHB host interface, the
	  firmware download path and the WMT function power sequencing, and
	  exposes one cfg80211 station interface plus its Ethernet netdev.

	  Supported feature set, and nothing beyond it:

	  - station (infrastructure) mode on 2.4 GHz channels 1 to 14,
	    legacy rates only, no 5 GHz band;
	  - open (no encryption) networks only.  There is no key offload,
	    so WPA/WPA2/802.1X association requests are rejected with
	    -EOPNOTSUPP instead of associating unencrypted;
	  - software scan: probe requests are built by the host and sent
	    through the HIF, beacons and probe responses received from the
	    HIF are reported to cfg80211.  Passive scans send no frames;
	  - no AP, IBSS, mesh, P2P or monitor interface, no hardware scan,
	    no scheduled scan, no remain-on-channel and no WoWLAN.

	  The interface is controlled through cfg80211 only (iw,
	  wpa_supplicant); the driver registers no private character
	  device or ioctl ABI.

	  Building without CONFIG_RFKILL is supported; the rfkill switch is
	  then simply absent and WLAN is controlled through WMT.

	  The module is called mtk_wcn_wlan.
```

## code/drivers/misc/mediatek/connectivity/wmt/Kconfig
```kconfig
# SPDX-License-Identifier: GPL-2.0
#
# WMT/CONSYS core: STP transport, WMT control protocol and the MT6735
# connectivity-subsystem power/clock/GPIO glue.

config MTK_WCN_WMT
	tristate "MediaTek WMT/CONSYS core"
	depends on MTK_BTIF
	depends on ARCH_MEDIATEK || COMPILE_TEST
	help
	  Core driver for the MediaTek connectivity subsystem (CONSYS).  It
	  owns the STP serial transport, the WMT control protocol, firmware
	  patch download and the power/clock/reset sequence used by the
	  WLAN, Bluetooth, GPS and FM functions.

	  The module is called mtk_wcn_wmt.
```

## code/drivers/misc/mediatek/vcodec/Kconfig
```kconfig
# SPDX-License-Identifier: GPL-2.0-only

config MTK_VCODEC_MT6735
	tristate "MediaTek MT6735 video codec hardware service"
	depends on ARCH_MEDIATEK || COMPILE_TEST
	depends on COMMON_CLK
	depends on PM
	help
	  Shared power, clock, interrupt and hardware-ownership services for
	  the MediaTek MT6735 VENC (encoder) and VDEC (decoder) video codec
	  engines.  Ported from the Samsung/MediaTek downstream
	  drivers/misc/mediatek/videocodec driver.

	  The codec register sequences themselves are executed by the vendor
	  userspace codec libraries through the register windows exported by
	  this driver; no codec firmware runs in the kernel.
```
